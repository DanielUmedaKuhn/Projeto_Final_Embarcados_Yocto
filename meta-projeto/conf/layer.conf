## meta-projeto/conf/layer.conf
```bitbake
BBPATH .= ":${LAYERDIR}"
BBFILES += "${LAYERDIR}/recipes-*/*/*.bb ${LAYERDIR}/recipes-*/*/*.bbappend"

BBFILE_COLLECTIONS += "meta-projeto-sensor"
BBFILE_PATTERN_meta-projeto-sensor = "^${LAYERDIR}/"
LAYERVERSION_meta-projeto-sensor = "1"
LAYER_SERIES_COMPAT_meta-projeto-sensor = "kirkstone"
```
